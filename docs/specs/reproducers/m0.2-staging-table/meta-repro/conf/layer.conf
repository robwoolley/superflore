## docs/specs/reproducers/m0.2-staging-table/meta-repro/conf/layer.conf
```bitbake
BBPATH .= ":${LAYERDIR}"
BBFILES += "${LAYERDIR}/recipes-*/*/*.bb"
BBFILE_COLLECTIONS += "meta-repro"
BBFILE_PATTERN_meta-repro = "^${LAYERDIR}/"
BBFILE_PRIORITY_meta-repro = "10"
LAYERSERIES_COMPAT_meta-repro = "wrynose"
```

## docs/specs/reproducers/m0.3-nothing-provides/meta-repro2/conf/layer.conf
```bitbake
BBPATH .= ":${LAYERDIR}"
BBFILES += "${LAYERDIR}/recipes-*/*/*.bb"
BBFILE_COLLECTIONS += "meta-repro2"
BBFILE_PATTERN_meta-repro2 = "^${LAYERDIR}/"
BBFILE_PRIORITY_meta-repro2 = "10"
LAYERSERIES_COMPAT_meta-repro2 = "wrynose"
```
